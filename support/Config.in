## support/Config.in
```kconfig
config BR2_PACKAGE_BLKPG_PART
	bool "blkpg-part"
	default y
	help
	  Partition table and disk geometry handling utility.
```

## support/oe/meta-blkpg-part/conf/layer.conf
```bitbake
# We have a conf and classes directory, append to BBPATH
BBPATH .= ":${LAYERDIR}"

# We have a recipes directory, add to BBFILES
BBFILES += "${LAYERDIR}/recipes*/*/*.bb ${LAYERDIR}/recipes*/*/*.bbappend"

BBFILE_COLLECTIONS += "blkpg-part"
BBFILE_PATTERN_blkpg-part := "^${LAYERDIR}/"
BBFILE_PRIORITY_blkpg-part = "5"

LAYERSERIES_COMPAT_blkpg-part = "kirkstone scarthgap styhead"
```
